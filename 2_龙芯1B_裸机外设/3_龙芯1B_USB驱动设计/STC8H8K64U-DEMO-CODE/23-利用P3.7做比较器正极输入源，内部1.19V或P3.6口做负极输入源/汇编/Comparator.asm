;/*---------------------------------------------------------------------*/
;/* --- STC MCU Limited ------------------------------------------------*/
;/* --- STC 1T Series MCU Demo Programme -------------------------------*/
;/* --- Mobile: (86)13922805190 ----------------------------------------*/
;/* --- Fax: 86-0513-55012956,55012947,55012969 ------------------------*/
;/* --- Tel: 86-0513-55012928,55012929,55012966 ------------------------*/
;/* --- Web: www.STCMCU.com --------------------------------------------*/
;/* --- Web: www.STCMCUDATA.com ----------------------------------------*/
;/* --- QQ:  800003751 -------------------------------------------------*/
;/* 如果要在程序中使用此代码,请在程序中注明使用了STC的资料及程序        */
;/*---------------------------------------------------------------------*/


;*************  功能说明    **************

;本例程基于STC8H8K64U为主控芯片的实验箱8进行编写测试，STC8G、STC8H系列芯片可通用参考.

;比较器的正极可以是 P3.7 端口或者 ADC 的模拟输入通道，

;而负极可以是 P3.6 端口或者是内部 BandGap 经过 OP 后的 REFV 电压（1.19V内部固定比较电压）。

;通过中断或者查询方式读取比较器比较结果，CMP+的电平低于CMP-的电平P47口输出低电平(LED10亮)，反之输出高电平(LED10灭)。

;下载时, 选择时钟 24MHZ (用户可自行修改频率).

;******************************************

;/****************************** 用户定义宏 ***********************************/

Fosc_KHZ    EQU 24000   ;24MHZ

STACK_POIRTER   EQU     0D0H    ; 堆栈开始地址

;*******************************************************************
;*******************************************************************

P_SW2     DATA 0BAH
CMPCR1    DATA 0E6H
CMPCR2    DATA 0E7H
P4        DATA 0C0H

P0M1    DATA    0x93    ; P0M1.n,P0M0.n     =00--->Standard,    01--->push-pull
P0M0    DATA    0x94    ;                   =10--->pure input,  11--->open drain
P1M1    DATA    0x91    ; P1M1.n,P1M0.n     =00--->Standard,    01--->push-pull
P1M0    DATA    0x92    ;                   =10--->pure input,  11--->open drain
P2M1    DATA    0x95    ; P2M1.n,P2M0.n     =00--->Standard,    01--->push-pull
P2M0    DATA    0x96    ;                   =10--->pure input,  11--->open drain
P3M1    DATA    0xB1    ; P3M1.n,P3M0.n     =00--->Standard,    01--->push-pull
P3M0    DATA    0xB2    ;                   =10--->pure input,  11--->open drain
P4M1    DATA    0xB3    ; P4M1.n,P4M0.n     =00--->Standard,    01--->push-pull
P4M0    DATA    0xB4    ;                   =10--->pure input,  11--->open drain
P5M1    DATA    0xC9    ; P5M1.n,P5M0.n     =00--->Standard,    01--->push-pull
P5M0    DATA    0xCA    ;                   =10--->pure input,  11--->open drain
P6M1    DATA    0xCB    ; P6M1.n,P6M0.n     =00--->Standard,    01--->push-pull
P6M0    DATA    0xCC    ;                   =10--->pure input,  11--->open drain
P7M1    DATA    0xE1    ;
P7M0    DATA    0xE2    ;
        
;*************  IO口定义    **************/


;*************  本地变量声明    **************/


;*******************************************************************
;*******************************************************************
        ORG     0000H               ;reset
        LJMP    F_Main

        ORG     00ABH               ;21  CMP interrupt
        LJMP    F_CMP_Interrupt


;*******************************************************************
;*******************************************************************


;******************** 主程序 **************************/
        ORG     0100H       ;reset
F_Main:
    CLR     A
    MOV     P0M1, A     ;设置为准双向口
    MOV     P0M0, A
    MOV     P1M1, A     ;设置为准双向口
    MOV     P1M0, A
    MOV     P2M1, A     ;设置为准双向口
    MOV     P2M0, A
    MOV     P3M1, A     ;设置为准双向口
    MOV     P3M0, A
    MOV     P4M1, A     ;设置为准双向口
    MOV     P4M0, A
    MOV     P5M1, A     ;设置为准双向口
    MOV     P5M0, A
    MOV     P6M1, A     ;设置为准双向口
    MOV     P6M0, A
    MOV     P7M1, A     ;设置为准双向口
    MOV     P7M0, A

    
    MOV     SP, #STACK_POIRTER
    MOV     PSW, #0
    USING   0       ;选择第0组R0~R7

;================= 用户初始化程序 ====================================

    ANL     P_SW2, #NOT 08H     ; 选择P3.4作为比较器输出脚
    CLR     A
    ANL     A, #NOT 080H        ;比较器正向输出
;    ORL     A, #080H            ;比较器反向输出
    ANL     A, #NOT 040H        ;使能0.1us滤波
;    ORL     A, #040H            ;禁止0.1us滤波
;    ANL     A, #NOT 03FH        ;比较器结果直接输出
    ORL     A, #010H            ;比较器结果经过16个去抖时钟后输出
    MOV     CMPCR2, A

    CLR     A
    ORL     A, #030H            ;使能比较器边沿中断
;    ANL     A, #NOT 020H        ;禁止比较器上升沿中断
;    ORL     A, #020H            ;使能比较器上升沿中断
;    ANL     A, #NOT 010H        ;禁止比较器下降沿中断
;    ORL     A, #010H            ;使能比较器下降沿中断
    ANL     A, #NOT 08H         ;P3.7为CMP+输入脚
;    ORL     A, #08H             ;ADC输入脚为CMP+输入教
    ANL     A, #NOT 04H         ;内部参考电压为CMP-输入脚
;    ORL     A, #04H             ;P3.6为CMP-输入脚
;    ANL     A, #NOT 02H         ;禁止比较器输出
    ORL     A, #02H             ;使能比较器输出
    ORL     A, #080H            ;使能比较器模块
    MOV     CMPCR1, A

;    MOV     CMPCR2, #10H        ; 比较器正向输出,使能0.1us滤波,比较器结果经过16个去抖时钟后输出
;    MOV     CMPCR1, #0B2H       ; 使能比较器模块,使能比较器边沿中断,P3.7为CMP+输入脚,内部参考电压为CMP-输入脚,使能比较器输出
    SETB    EA          ; 打开总中断
    
;=================== 主循环 ==================================
L_MainLoop:

    ;MOV     A, CMPCR1
	;RRC     A
	;MOV     P4.7,C

    LJMP    L_MainLoop

;**********************************************/


;========================================================================
; 函数: F_CMP_Interrupt
; 描述: 比较器中断函数.
; 参数: non.
; 返回: non.
; 版本: V1.0, 2021-3-3
;========================================================================
F_CMP_Interrupt:
    PUSH    PSW
    PUSH    ACC
    PUSH    AR2

    ANL     CMPCR1, #NOT 040H      ; 清中断标志
    MOV     A, CMPCR1
	RRC     A
	MOV     P4.7,C

L_QuitCMP_Init:
    POP     AR2
    POP     ACC
    POP     PSW
    RETI

;*******************************************************************

    END

